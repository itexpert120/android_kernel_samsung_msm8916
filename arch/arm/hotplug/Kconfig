## arch/arm/hotplug/Kconfig
```kconfig
config INTELLI_PLUG
        bool "Enable intelli-plug cpu hotplug driver"
        default n
        help
          Generic Intelli-plug cpu hotplug driver for ARM SOCs

config MSM_HOTPLUG
	bool "MSM hotplug driver"
	depends on HOTPLUG_CPU
	default n
	help
	  The MSM hotplug driver controls on-/offlining of additional cores based
	  on current cpu load.

config BRICKED_HOTPLUG
	   bool "Enable kernel based mpdecision"
	   depends on MSM_RUN_QUEUE_STATS
	   default n
	   help
		 This enables kernel based multi core control.

config ALUCARD_HOTPLUG
	bool "Enable alucard-hotplug cpu hotplug driver"
	default y
	help
	Generic Alucard-hotplug cpu hotplug driver for ARM SOCs
```
